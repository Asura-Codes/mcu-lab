## CMakeLists.txt
```
cmake_minimum_required(VERSION 3.20.0)

# Locate Zephyr from the upstream Zephyr workspace
find_package(Zephyr REQUIRED HINTS $ENV{ZEPHYR_BASE})

project(nrf52840_template
    VERSION 1.0.0
    DESCRIPTION "nRF52840 blink template (Zephyr RTOS v4.2.2)"
    LANGUAGES C
)

target_sources(app PRIVATE src/main.c)
```

## prj.conf
```kconfig
# nRF52840 template - Kconfig fragments
# Board: promicro_nrf52840
# Build: cmake -B build -DBOARD=promicro_nrf52840 . && cmake --build build -j4

# GPIO subsystem (required for LED control)
CONFIG_GPIO=y

# Link at flash base for direct JTAG/OpenOCD debug reset flow.
CONFIG_FLASH_LOAD_OFFSET=0

# USB enabled, but initialize it from main() to avoid pre-main USB lockups.
CONFIG_USB_DEVICE_INITIALIZE_AT_BOOT=n

# Set non-default VID/PID to avoid Zephyr USB test VID/PID warnings.
CONFIG_USB_DEVICE_VID=0x1209
CONFIG_USB_DEVICE_PID=0x5284
```

## app.overlay
```dts
/* nRF52840 Pro Micro devicetree overlay - empty by default */

/ {
};
```

## src/main.c
```c
/**
 * nRF52840 Template — Zephyr RTOS v4.2.2
 * Board : promicro_nrf52840
 * LED   : led0 alias from board devicetree
 *
 * Build (container):
 *   cmake -B build -DBOARD=promicro_nrf52840 . && cmake --build build -j4
 *
 * Flash (Windows host — host-only):
 *   nrfjprog --program build/zephyr/zephyr.hex --chiperase --verify --reset
 *   # or: openocd -f interface/cmsis-dap.cfg -f target/nordic/nrf52.cfg \
 *   #             -c "program build/zephyr/zephyr.elf verify reset exit"
 */

#include <errno.h>
#include <zephyr/kernel.h>
#include <zephyr/device.h>
#include <zephyr/drivers/gpio.h>
#include <zephyr/sys/printk.h>
#include <zephyr/usb/usb_device.h>

/* Get LED0 from board devicetree */
static const struct gpio_dt_spec led = GPIO_DT_SPEC_GET(DT_ALIAS(led0), gpios);

int main(void)
{
    int ret = usb_enable(NULL);
    if ((ret != 0) && (ret != -EALREADY))
    {
        return ret;
    }

    printk("main reached\n");

    if (!device_is_ready(led.port))
    {
        printk("LED device not ready\n");
        return -1;
    }

    ret = gpio_pin_configure_dt(&led, GPIO_OUTPUT_ACTIVE);
    if (ret < 0)
    {
        printk("Failed to configure LED: %d\n", ret);
        return ret;
    }

    printk("LED configured, starting blink loop\n");

    uint32_t toggle_count = 0;
    while (1)
    {
        gpio_pin_toggle_dt(&led);
        toggle_count++;
        printk("Toggle count: %u\n", toggle_count);
        k_msleep(500);
    }

    return 0;
}
```
